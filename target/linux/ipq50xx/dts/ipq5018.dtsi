#ifdef __ARM32__
	// Search in arch/arm/boot/dts/
	#include <../../../arm64/boot/dts/qcom/ipq5018.dtsi>
	#include <qcom-ipq5018.dtsi>
#elif __AARCH64__
	// Search in arch/arm64/boot/dts/
	#include <qcom/ipq5018.dtsi>
#else
	#error "Please define __ARM32__ or __AARCH64__ when compiling dts"
#endif
